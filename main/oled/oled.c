#include "oled.h"
#include "driver/i2c_master.h"
#include "esp_err.h"
#include <string.h>

static const uint8_t font5x7[95][5] = {
    {0x00, 0x00, 0x00, 0x00, 0x00},
    {0x00, 0x00, 0x5F, 0x00, 0x00},
    {0x00, 0x07, 0x00, 0x07, 0x00},
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    {0x10, 0x08, 0x08, 0x10, 0x08},
};

static void oled_send_cmd_internal(oled_state_t *state, uint8_t cmd) {
    uint8_t buf[2] = {0x00, cmd};
    ESP_ERROR_CHECK(
        i2c_master_transmit(state->i2c_handle, buf, 2, 1000));
}

static void oled_send_data_internal(oled_state_t *state, uint8_t *data,
                                    size_t len) {
    uint8_t buf[len + 1];
    buf[0] = 0x40;
    memcpy(buf + 1, data, len);
    ESP_ERROR_CHECK(
        i2c_master_transmit(state->i2c_handle, buf, len + 1, 1000));
}

void oled_send_cmd(oled_state_t *state, uint8_t cmd) {
    oled_send_cmd_internal(state, cmd);
}

void oled_send_data(oled_state_t *state, uint8_t *data, size_t len) {
    oled_send_data_internal(state, data, len);
}

void oled_clear_display(oled_state_t *state) {
    uint8_t empty[OLED_COLS];
    memset(empty, 0x00, sizeof(empty));

    for (int page = 0; page < OLED_PAGES; page++) {
        oled_send_cmd_internal(state, 0xB0 + page);
        oled_send_cmd_internal(state, 0x00);
        oled_send_cmd_internal(state, 0x10);
        oled_send_data_internal(state, empty, sizeof(empty));
    }
}

void oled_fill_white(oled_state_t *state) {
    uint8_t white[OLED_COLS];
    memset(white, 0xFF, sizeof(white));

    for (int page = 0; page < OLED_PAGES; page++) {
        oled_send_cmd_internal(state, 0xB0 + page);
        oled_send_cmd_internal(state, 0x00);
        oled_send_cmd_internal(state, 0x10);
        oled_send_data_internal(state, white, sizeof(white));
    }
}

void oled_draw_char(oled_state_t *state, char c, uint8_t col, uint8_t page) {
    if (c < 32 || c > 126)
        return;
    uint8_t buffer[5];
    memcpy(buffer, font5x7[c - 32], 5);

    oled_send_cmd_internal(state, 0xB0 + page);
    oled_send_cmd_internal(state, 0x00 + (col & 0x0F));
    oled_send_cmd_internal(state, 0x10 + (col >> 4));
    oled_send_data_internal(state, buffer, 5);
}

void oled_draw_string(oled_state_t *state, const char *str, uint8_t col,
                      uint8_t page) {
    while (*str) {
        oled_draw_char(state, *str++, col, page);
        col += OLED_CHAR_WIDTH;
        if (col > OLED_COLS - OLED_CHAR_WIDTH) {
            col = 0;
            page++;
            if (page > OLED_PAGES - 1)
                page = 0;
        }
    }
}

oled_state_t oled_init(i2c_master_dev_handle_t handle) {
    oled_state_t state = {
        .i2c_handle = handle,
        .dirty = false,
        .shift_offset = 0,
        .shift_timer = 0,
    };

    for (int i = 0; i < OLED_PAGES; i++) {
        state.pages[i][0] = '\0';
    }

    oled_send_cmd_internal(&state, 0xAE);
    oled_send_cmd_internal(&state, 0xD5);
    oled_send_cmd_internal(&state, 0x80);
    oled_send_cmd_internal(&state, 0xA8);
    oled_send_cmd_internal(&state, 0x3F);
    oled_send_cmd_internal(&state, 0xD3);
    oled_send_cmd_internal(&state, 0x00);
    oled_send_cmd_internal(&state, 0x40);
    oled_send_cmd_internal(&state, 0x8D);
    oled_send_cmd_internal(&state, 0x14);
    oled_send_cmd_internal(&state, 0xA1);
    oled_send_cmd_internal(&state, 0xC8);
    oled_send_cmd_internal(&state, 0xDA);
    oled_send_cmd_internal(&state, 0x12);
    oled_send_cmd_internal(&state, 0x81);
    oled_send_cmd_internal(&state, 0xCF);
    oled_send_cmd_internal(&state, 0xD9);
    oled_send_cmd_internal(&state, 0xF1);
    oled_send_cmd_internal(&state, 0xDB);
    oled_send_cmd_internal(&state, 0x40);
    oled_send_cmd_internal(&state, 0xA4);
    oled_send_cmd_internal(&state, 0xA6);
    oled_send_cmd_internal(&state, 0xAF);
    oled_send_cmd_internal(&state, 0x20);
    oled_send_cmd_internal(&state, 0x02);

    oled_clear_display(&state);

    return state;
}

void oled_set_text(oled_state_t *state, uint8_t page, const char *text) {
    if (page >= OLED_PAGES)
        return;

    strlcpy(state->pages[page], text, OLED_PAGE_CHARS + 1);
    state->dirty = true;
}

void oled_clear_pages(oled_state_t *state) {
    for (int i = 0; i < OLED_PAGES; i++) {
        state->pages[i][0] = '\0';
    }
    state->dirty = true;
}

void oled_redraw(oled_state_t *state) {
    uint8_t empty[OLED_COLS];
    memset(empty, 0x00, sizeof(empty));

    for (int page = 0; page < OLED_PAGES; page++) {
        oled_send_cmd_internal(state, 0xB0 + page);
        oled_send_cmd_internal(state, 0x00);
        oled_send_cmd_internal(state, 0x10);
        oled_send_data_internal(state, empty, sizeof(empty));

        if (state->pages[page][0] != '\0') {
            uint8_t col = state->shift_offset >= 0 ? (uint8_t)state->shift_offset
                                                   : 0;
            oled_draw_string(state, state->pages[page], col, page);
        }
    }

    state->dirty = false;
}
